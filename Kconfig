## Kconfig
```kconfig
mainmenu "HIT-CGRA-Mapper Configuration Menu"

menu "Build Options"
choice
  prompt "Compiler"
  default CC_GPP
config CC_GPP
  bool "g++"
config CC_CLANG
  bool "clang++-12"
endchoice

config CC
  string
  default "g++" if CC_GPP
  default "clang" if CC_CLANG
  default "none"

choice
  prompt "Optimization Level"
  default CC_O2
config CC_O0
  bool "O0"
config CC_O1
  bool "O1"
config CC_O2
  bool "O2"
config CC_O3
  bool "O3"
endchoice

config CC_OPT
  string
  default "-O0" if CC_O0
  default "-O1" if CC_O1
  default "-O2" if CC_O2
  default "-O3" if CC_O3
  default "none"

config CC_DEBUG
  bool "Enable gdb information"
  default n
endmenu


menu "Debugging"

config DFG_DEBUG
  bool "Enable DFG debug print"
  default y
config CGRA_DEBUG
  bool "Enable CGRA debug print"
  default y
menu "MAP_DEBUG"
config MAP_DEBUG
  bool "Enable MAP debug print"
  default y
config MAP_DEBUG_PATH
	depends on MAP_DEBUG
  bool "Enable find path detail print"
  default n
endmenu

config BITSTREAM_DEBUG
	bool "Enable bitstream debug print"
	default y
endmenu

menu "DFG config"

config DFG_FULL_INST 
  bool "Show the full Inst in DFG"
  default n
config DFG_LEVEL
	bool "Show node's level in DFG"
	default y
config DFG_LONGEST
	bool "Show the longest path in DFG "
	default y
config DFG_SRC_ID
	bool "Show the srcID of DFGEdge in DFG "
	default y
endmenu

menu "MAP config"
config MAP_EN
  bool "Enable MAP"
  default y
config MAP_CONSTRAINT
	depends on MAP_EN
  bool "Map load and store to a certain CGRANode."
  default y

choice
	depends on MAP_EN
	prompt "route algorithm"
	default MAP_A
config MAP_A
	bool "Use A* to route"
config MAP_BFS
  bool "Use BFS to route"
endchoice
endmenu

menu "BitStream config"
config MAP_BITSTREAM
	depends on MAP_EN
	bool "Generate bitstream"
	default y
config CGRA_INSTMEM_SIZE 
  int "Inst MEM size of each PE (uint:max number of Inst)"
  default 8
config CGRA_CONSTMEM_SIZE
	int "Const Mem size of each PE (uint:max number of const)"
	default 8
config CGRA_SHIFTCONSTMEM_SIZE
	int "Shift Const Mem size of each PE (uint:max number of shift const)"
	default 8

menu "i config"
config LOOP_I_START 
  int "i start (int)"
  default 0
config LOOP_I_INC 
  int "i inc (int)"
  default 1
config LOOP_I_END 
  int "i end (int)"
  default 0
endmenu
menu "j config"
config LOOP_J_START 
  int "j start (int)"
  default 0
config LOOP_J_INC 
  int "j inc (int)"
  default 1
config LOOP_J_END 
  int "j end (int)"
  default 0
endmenu
menu "k config"
config LOOP_K_START 
  int "k start (int)"
  default 0
config LOOP_K_INC 
  int "k inc (int)"
  default 1
config LOOP_K_END 
  int "k end (int)"
  default 0
endmenu


endmenu
```
